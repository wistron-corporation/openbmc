## meta-wistron/meta-osprey/conf/layer.conf
```bitbake
# We have a conf and classes directory, add to BBPATH
BBPATH .= ":${LAYERDIR}"

# We have recipes-* directories, add to BBFILES
BBFILES += "${LAYERDIR}/recipes-*/*/*.bb \
            ${LAYERDIR}/recipes-*/*/*.bbappend"

BBFILE_COLLECTIONS += "osprey"
BBFILE_PATTERN_osprey = "^${LAYERDIR}/"
LAYERSERIES_COMPAT_osprey = "honister kirkstone"
```

## meta-wistron/meta-osprey/conf/machine/osprey.conf
```bitbake
KERNEL_DEVICETREE = "aspeed-ast2600-evb.dtb"

#require conf/machine/include/wistron.inc
require conf/machine/include/ast2600.inc
require conf/machine/include/obmc-bsp-common.inc

UBOOT_MACHINE = "ast2600_openbmc_spl_defconfig"
UBOOT_DEVICETREE = "ast2600a1-evb"
SPL_BINARY = "spl/u-boot-spl.bin"
SOCSEC_SIGN_ENABLE = "0"

SERIAL_CONSOLES = "115200;ttyS4"

FLASH_SIZE = "65536"

OBMC_MACHINE_FEATURES += "\
        obmc-chassis-state-mgmt \
        obmc-host-state-mgmt \
        "
VIRTUAL-RUNTIME_obmc-host-state-manager ?= "x86-power-control"
VIRTUAL-RUNTIME_obmc-chassis-state-manager ?= "x86-power-control"
```
